## boards/stm32/stm32_minidrone/Kconfig.stm32_minidrone
```kconfig
# STM32 minidrone Board Configuration

# SPDX-License-Identifier: Apache-2.0

config BOARD_STM32_MINIDRONE
	select SOC_STM32F103XB
```

## boards/stm32/stm32_minidrone/board.yml
```yaml
board:
  name: stm32_minidrone
  full_name: STM32 MiniDrone Board
  vendor: others
  socs:
    - name: stm32f103xb
```

## boards/stm32/stm32_minidrone/stm32_minidrone_defconfig
```kconfig
# STM32 minidrone Board Configuration
#
# SPDX-License-Identifier: Apache-2.0

# Clock
CONFIG_CLOCK_CONTROL=y

# GPIO
CONFIG_GPIO=y

# Pin controller
CONFIG_PINCTRL=y

# Console
CONFIG_SERIAL=y
CONFIG_CONSOLE=y
CONFIG_UART_CONSOLE=y

# UART (for Bluetooth HM-13)
CONFIG_UART_INTERRUPT_DRIVEN=y

# I2C (for MPU6050)
CONFIG_I2C=y

# PWM (for motors)
CONFIG_PWM=y

# ADC (for battery)
CONFIG_ADC=y

# Sensor subsystem (MPU6050)
CONFIG_SENSOR=y

# Watchdog
CONFIG_WATCHDOG=y
```

## tests/core/testcase.yaml
```yaml
# SPDX-License-Identifier: Apache-2.0

tests:
  core.pure:
    tags: unit pure_core
    platform_allow: native_sim
```

## west.yml
```yaml
# SPDX-License-Identifier: Apache-2.0

manifest:
  self:
    west-commands: scripts/west-commands.yml

  remotes:
    - name: zephyrproject-rtos
      url-base: https://github.com/zephyrproject-rtos

  projects:
    - name: zephyr
      remote: zephyrproject-rtos
      revision: v4.1.0
      import:
        name-allowlist:
          - cmsis      # required by the ARM port
          - hal_stm32  # required by the STM32 based board
          - cmsis-dsp  # required by the PID controller
```
